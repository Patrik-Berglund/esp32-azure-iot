## examples/iothub_client_sample_mqtt/main/Kconfig.projbuild
```kconfig
menu "Example Configuration"

config WIFI_SSID
    string "WiFi SSID"
	default "myssid"
	help
		SSID (network name) for the example to connect to.

config WIFI_PASSWORD
    string "WiFi Password"
	default "myssid"
	help
		WiFi password (WPA or WPA2) for the example to use.
		Can be left blank if the network has no security set.

config IOTHUB_DPS_PROVISIONING_URI
    string "IOT Hub Device Connection String"
	default ""
	help

config IOTHUB_DPS_ID_SCOPE
    string "IOT Hub Device Connection String"
	default ""
	help

config IOTHUB_DPS_REGISTRATION_NAME
    string "IOT Hub Device Connection String"
	default ""
	help

config IOTHUB_DPS_PRIMARY_KEY
	string "IOT Hub Device Connection String"
	default ""
	help

config IOTHUB_DPS_SECONDARY_KEY
	string "IOT Hub Device Connection String"
	default ""
	help

endmenu
```

## main/Kconfig.projbuild
```kconfig
menu "Example Configuration"

config WIFI_SSID
    string "WiFi SSID"
	default "myssid"

config WIFI_PASSWORD
    string "WiFi Password"
	default "myssid"

config IOTHUB_DPS_PROVISIONING_URI
    string "IOTHUB_DPS_PROVISIONING_URI"
	default ""

config IOTHUB_DPS_ID_SCOPE
    string "IOTHUB_DPS_ID_SCOPE"
	default ""

config IOTHUB_DPS_REGISTRATION_NAME
    string "IOTHUB_DPS_REGISTRATION_NAME"
	default ""

config IOTHUB_DPS_PRIMARY_KEY
	string "IOTHUB_DPS_PRIMARY_KEY"
	default ""

config IOTHUB_DPS_SECONDARY_KEY
	string "IOTHUB_DPS_SECONDARY_KEY"
	default ""

endmenu
```
